/**
  ******************************************************************************
  * File Name          : main.c
  * Description        : Main program body
  ******************************************************************************
  */
#include <string.h>
#include "board.h"
#include "hal_key.h"
#include "tim-board.h"
#include "timer_handles.h"

#include "NS_Radio.h"


#include "usart1-board.h"

	/*extern */unsigned char State /*= 0xff*/;

unsigned char du[] = {
	/*--  文字:  °  --*/
/*--  宋体12;  此字体下对应的点阵为：宽x高=16x16   --*/
0x00,0x00,0x0C,0x12,0x12,0x0C,0x00,0x00,0x00,0x00,0x00,0x00,0x00,0x00,0x00,0x00,
0x00,0x00,0x00,0x00,0x00,0x00,0x00,0x00,0x00,0x00,0x00,0x00,0x00,0x00,0x00,0x00,

};

unsigned char kaiguan[][32] = {

	/*--  文字:  开  --*/
/*--  宋体12;  此字体下对应的点阵为：宽x高=16x16   --*/
0x80,0x82,0x82,0x82,0xFE,0x82,0x82,0x82,0x82,0x82,0xFE,0x82,0x82,0x82,0x80,0x00,
0x00,0x80,0x40,0x30,0x0F,0x00,0x00,0x00,0x00,0x00,0xFF,0x00,0x00,0x00,0x00,0x00,

/*--  文字:  关  --*/
/*--  宋体12;  此字体下对应的点阵为：宽x高=16x16   --*/
0x00,0x00,0x10,0x11,0x16,0x10,0x10,0xF0,0x10,0x10,0x14,0x13,0x10,0x00,0x00,0x00,
0x81,0x81,0x41,0x41,0x21,0x11,0x0D,0x03,0x0D,0x11,0x21,0x41,0x41,0x81,0x81,0x00,
};

unsigned char kai_image[] = {
/*--  调入了一幅图像：C:\Users\chen\Desktop\kai.bmp  --*/
/*--  宽度x高度=48x48  --*/
0x00,0x00,0x00,0x00,0x00,0x00,0x00,0x00,0x00,0x00,0x00,0x00,0x00,0x00,0xE0,0xE0,
0x60,0x60,0xE0,0xC0,0x00,0xF8,0xB8,0x18,0x18,0xB8,0xF8,0x00,0xC0,0xE0,0x60,0x60,
0xE0,0xE0,0x00,0x00,0x00,0x00,0x00,0x00,0x00,0x00,0x00,0x00,0x00,0x00,0x00,0x00,
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0x00,0x00,0x00,0x00,0x00,0x00,0x00,0x00,0x00,0x00,0x00,0x00,0x00,0x00,0x00,0x00,

};

unsigned char guan_image[] = {
/*--  调入了一幅图像：C:\Users\chen\Desktop\关.bmp  --*/
/*--  宽度x高度=48x48  --*/
0x00,0x00,0x00,0x00,0x00,0x00,0x00,0x00,0x00,0x00,0x00,0x00,0x00,0x00,0x00,0x00,
0x00,0x00,0x00,0x00,0x00,0x00,0x00,0x00,0x00,0x00,0x00,0x00,0x00,0x00,0x00,0x00,
0x00,0x00,0x00,0x00,0x00,0x00,0x00,0x00,0x00,0x00,0x00,0x00,0x00,0x00,0x00,0x00,
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0x00,0x00,0x00,0x00,0x00,0x00,0x00,0x00,0x00,0x00,0x00,0x00,0x00,0x00,0x00,0x00,

	
};
unsigned char hx_image[] = {
/*--  调入了一幅图像：C:\Users\chen\Desktop\hx.bmp  --*/
/*--  宽度x高度=48x48  --*/
0x00,0x00,0x00,0x00,0x00,0x00,0x00,0x00,0x00,0x00,0x00,0x00,0x00,0x00,0xE0,0xE0,
0x60,0x60,0xE0,0xC0,0x00,0x00,0x00,0x00,0x00,0x00,0x00,0x00,0xC0,0xE0,0x60,0x60,
0xE0,0xE0,0x00,0x00,0x00,0x00,0x00,0x00,0x00,0x00,0x00,0x00,0x00,0x00,0x00,0x00,
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0x00,0x00,0x00,0x00,0x00,0x00,0x00,0x00,0x00,0x00,0x00,0x00,0x00,0x00,0x00,0x00,

};

/**********************************************************************************************
*函数：void Init( void )
*功能：平台初始化
*输入：无
*输出：无
*特殊说明：无
**********************************************************************************************/
void Init() {
    // 开发板平台初始化
    BoardInitMcu();
    BoardInitPeriph();
    keys_init();//按键初始化
    setTimer2Callback(Time2Handler);
    Tim2McuInit(1);//定时器初始化，设置定时中断1ms中断一次
	 
}

/**********************************************************************************************
*函数：void KeyDownHandler( void )
*功能：按钮事件监听
*输入：无
*输出：无
*特殊说明：无
**********************************************************************************************/
void KeyDownHandler(void) {

	
}

/**********************************************************************************************
*函数：void handlerPre10Ms( void )
*功能：10毫秒循环
*输入：无
*输出：无
*特殊说明：循环处理总时长300ms
**********************************************************************************************/
void handlerPre10Ms(void) {
    for (int delay = 0; delay < 30; delay++) {
        HAL_Delay(10);
        
    }
}
//void Lora_Read();
void Led2_HX(){

	unsigned int time=1000,i,j;
	unsigned char R[10];
	OLED_DrawBMP(128/2-48,0,48,48,kai_image);
	for(i = 0;i < time;i++){
		
		for(j = 0;j < i;j++){
			GpioWrite(&Led2,0);
						
			
			if(State!=5)break;
		}
		for(j = 0;j <time - i;j++){
			GpioWrite(&Led2,1);

			if(State!=5)break;
		}
	}
	OLED_DrawBMP(128/2-48,0,48,48,hx_image);
	for(i = 0;i < time;i++){
		
		for(j = 0;j < i;j++){
			GpioWrite(&Led2,1);

			if(State!=5)break;
		}
		for(j = 0;j <time - i;j++){
			GpioWrite(&Led2,0);

			if(State!=5)break;
		}
		
	}OLED_DrawBMP(128/2-48,0,48,48,guan_image);	
				GpioWrite(&Led2,1);
}



unsigned int t = 0,T = 0;

unsigned char arr[10];
void OLED_State(){
	
	switch(State){
		
		case 0:

		OLED_ShowString(32,3,arr);
		OLED_ShowString(32+6*8,3,"Lx");
			break;
		case 1:

		OLED_ShowString(32,3,arr);
		OLED_ShowCHineseArray(32+6*8,3,du);
		OLED_ShowChar(32+6*8+16,3,'C');
			
			break;
		case 2:

		OLED_ShowString(32,3,arr);
		OLED_ShowString(32+6*8,3,"%RH");
			
			break;
		case 3:
			GpioWrite(&Led1,0);
		OLED_DrawBMP(128/2-48,0,48,48,kai_image);
			OLED_ShowString(128/2-48,6,"LED1");OLED_ShowCHineseArray(128/2-16,6,kaiguan[0]);
			break;
		case 4:
				GpioWrite(&Led1,1);
		OLED_DrawBMP(128/2-48,0,48,48,guan_image);
			OLED_ShowString(128/2-48,6,"LED1");OLED_ShowCHineseArray(128/2-16,6,kaiguan[1]);		
			break;
		case 5:
			Led2_HX();
		
			break;
		case 6:
		{
	//	HAL_Delay(1);	
		T++;
		if(T == 5){
			OLED_DrawBMP(128/2-48,0,48,48,kai_image);
			GpioWrite(&Led2,0);
		}
		else if(T == 10){
			T = 0;
			OLED_DrawBMP(128/2-48,0,48,48,guan_image);
			GpioWrite(&Led2,1);
		}
		}
			break;	
	}
	
	
}
/*
void Lora_Read(){
			unsigned char Read[10];
			if(Read[7]!=State)OLED_Clear();
			ReadRadioRxBuffer(Read);
			HAL_Delay(100);
			USART1_SendStr(Read,10);
			//HAL_Delay(100);
			if(Read[7]!=0)
						State = Read[7];
					Read[7] = '\0';
			sprintf(arr,"%s",Read);

}*/


/**
 * Main application entry point.
 */
int main( void )
{
	State = 0xff;
    Init();
	OLED_Init();
	
	NS_RadioInit(433000521,18,1000,1000);
USART1_Init(115200);
	//unsigned char test[10];
    while( 1 )
    {/*
ReadRadioRxBuffer(test);
			if(test[7] == 10)
						GpioWrite(&Led1,0);*/
			

			
			//Lora_Read();
			t++;
			HAL_Delay(1);	
			if(t % 100 == 0){
			unsigned char Read[10];
			
			ReadRadioRxBuffer(Read);
			if(Read[7]!=State)OLED_Clear();
			
			//HAL_Delay(200);
			//USART1_SendStr(Read,10);
			//HAL_Delay(100);

				State = Read[7];
					Read[7] = '\0';
			sprintf(arr,"%s",Read);			
				OLED_State();
			}
			
			
			

    }
}
