/**
  ******************************************************************************
  * File Name          : main.c
  * Description        : Main program body
  ******************************************************************************
  */
#include <string.h>
#include "board.h"
#include "hal_key.h"
#include "tim-board.h"
#include "timer_handles.h"

uint8_t  State = 0;

uint8_t ZCD[][32] ={

0x00,0x08,0x08,0x08,0x08,0x08,0x09,0xFA,0x08,0x08,0x08,0x08,0x08,0x08,0x00,0x00,
0x40,0x40,0x41,0x41,0x41,0x41,0x41,0x7F,0x41,0x41,0x41,0x41,0x41,0x40,0x40,0x00,


0x04,0x04,0x44,0xC4,0x4F,0x44,0x44,0xC4,0x24,0x24,0x2F,0xB4,0x24,0x04,0x04,0x00,
0x40,0x44,0x24,0x24,0x15,0x0C,0x04,0xFE,0x04,0x0C,0x15,0x24,0x24,0x44,0x40,0x00,

0x00,0x00,0xF8,0x49,0x4A,0x4C,0x48,0xF8,0x48,0x4C,0x4A,0x49,0xF8,0x00,0x00,0x00,
0x10,0x10,0x13,0x12,0x12,0x12,0x12,0xFF,0x12,0x12,0x12,0x12,0x13,0x10,0x10,0x00,


};

uint8_t QC_Code[]={
/*--  ???????:D:\?????_?????\?????????.assets\QC Code.bmp  --*/
/*--  ??x??=48x48  --*/
0xAC,0xFF,0xFE,0xFE,0xFE,0xDE,0xFE,0xFE,0xFE,0xFF,0xFF,0xFF,0xFE,0xFE,0xFF,0xFF,
0xFF,0xAC,0xFF,0xFF,0xFF,0xBD,0xFE,0x9F,0x9F,0xFF,0xFF,0xFE,0x8D,0x8D,0xAC,0xFF,
0xFE,0xFE,0xDE,0xDE,0xFF,0xFF,0xFE,0xFF,0xFF,0xFE,0xDF,0xFF,0xFE,0xFE,0xFF,0xD2,
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0x36,0x7B,0xFF,0xFF,0x7F,0x7F,0x3D,0xFF,0xFF,0x7F,0xFB,0xFF,0xCF,0xCF,0x0F,0x75,
};

uint8_t wifi[] = {
/*--  ???????:D:\?????_?????\?????????.assets\wifi.bmp  --*/
/*--  ??x??=48x48  --*/
0x00,0x00,0x00,0x00,0x80,0x80,0x80,0xE0,0xE0,0xF0,0xF8,0xF8,0xF8,0xFE,0xFE,0xFF,
0xFF,0xFF,0xFF,0xFF,0xFF,0xFF,0xFF,0xFF,0xFF,0xFF,0xFF,0xFF,0xFF,0xFF,0xFF,0xFE,
0xFE,0xF8,0xF8,0xF8,0xF0,0xE0,0xE0,0x80,0x80,0x00,0x00,0x00,0x00,0x00,0x00,0x00,
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0x00,0x00,0x00,0x00,0x00,0x00,0x00,0x00,0x00,0x00,0x00,0x00,0x00,0x00,0x00,0x00,

};

void KEY_STATE();

/**********************************************************************************************
*函数：void Init( void )
*功能：平台初始化
*输入：无
*输出：无
*特殊说明：无
**********************************************************************************************/
void Init() {
    // 开发板平台初始化
    BoardInitMcu();
    BoardInitPeriph();
    keys_init();//按键初始化
    setTimer2Callback(Time2Handler);
    Tim2McuInit(1);//定时器初始化，设置定时中断1ms中断一次
	 
}

/**********************************************************************************************
*函数：void KeyDownHandler( void )
*功能：按钮事件监听
*输入：无
*输出：无
*特殊说明：无
**********************************************************************************************/
void KeyDownHandler(void) {
	
	if(isKey2Pressed()){
		OLED_Clear();
		resetKey2();
		State = 1;
		KEY_STATE();
	}
	
	if(isKey3Pressed()){
		OLED_Clear();
		resetKey3();
		State = 2;
		KEY_STATE();
	}
	if(isKey4Pressed()){
		OLED_Clear();
		resetKey4();
		State = 3;
		KEY_STATE();
	}
	
}

/**********************************************************************************************
*函数：void handlerPre10Ms( void )
*功能：10毫秒循环
*输入：无
*输出：无
*特殊说明：循环处理总时长300ms
**********************************************************************************************/
void handlerPre10Ms(void) {
    for (int delay = 0; delay < 30; delay++) {
        HAL_Delay(10);
        
    }
}

void KEY_STATE(){
	if(State == 0){
		OLED_ShowCHineseArray(40,0,ZCD[0]);OLED_ShowCHineseArray(40+16,0,ZCD[1]);OLED_ShowCHineseArray(40+32,0,ZCD[2]);
		OLED_ShowString(16,2,"K2.Formula ");OLED_ShowString(16,4,"K3.WIFI ");OLED_ShowString(16,6,"K4.QRCode  ");
		}
	if(State == 1){
		OLED_ShowString(32,0,"Formula ");
		OLED_ShowString(0,3,"F:*************");
		}
	if(State == 2){
		OLED_ShowString(48,0,"WIFI");
		OLED_DrawBMP(40,2,48,48,wifi);
	}
		if(State == 3){
		OLED_ShowString(40,0,"QRCode");
		OLED_DrawBMP(40,2,48,48,QC_Code);
	}
	
}

/**
 * Main application entry point.
 */
int main( void )
{
    Init();
	OLED_Init();
	OLED_Clear();
	KEY_STATE();
    while( 1 )
    {
			KeyDownHandler();
    }
}
