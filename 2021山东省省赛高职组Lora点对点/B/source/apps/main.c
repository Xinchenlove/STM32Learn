/**
  ******************************************************************************
  * File Name          : main.c
  * Description        : Main program body
  ******************************************************************************
  */
#include <string.h>
#include "board.h"
#include "hal_key.h"
#include "tim-board.h"
#include "timer_handles.h"
#include "NS_Radio.h"


uint8_t arr[10];
uint8_t Z = 0,S = 0;
uint8_t state;

uint8_t BMP0[] = {
/*--  ???????:D:\?????_?????\2021????????Lora???.assets\0.bmp  --*/
/*--  ??x??=48x45  --*/
/*--  ????8???,????:??x??=48x48  --*/
0x00,0x00,0x00,0x00,0x00,0x00,0x00,0x00,0x00,0x00,0x00,0xC0,0xC0,0xE0,0xE0,0xE0,
0xE0,0xC0,0xE0,0xE0,0xE0,0xC0,0x80,0xC0,0xE0,0xE0,0xE0,0xE0,0xE0,0xE0,0xC0,0xE0,
0xE0,0xE0,0x80,0x00,0x00,0x00,0x00,0x00,0x00,0x00,0x00,0x00,0x00,0x00,0x00,0x00,
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0x0D,0x0D,0x0F,0x0F,0x0F,0x0F,0x0F,0x00,0x00,0x00,0x00,0x00,0x00,0x00,0x00,0x00,
};

uint8_t BMP1[] = {
/*--  ???????:D:\?????_?????\2021????????Lora???.assets\1.bmp  --*/
/*--  ??x??=48x48  --*/
0x00,0x00,0x00,0x00,0x00,0x00,0x00,0x00,0x00,0x00,0x00,0x00,0x00,0x00,0xE0,0xE0,
0xE0,0xE0,0xE0,0xE0,0xE0,0xE0,0xE0,0xE0,0xE0,0xA0,0xE0,0xE0,0xE0,0xE0,0xE0,0xE0,
0xE0,0xE0,0xE0,0xE0,0x40,0x40,0x00,0x00,0x00,0x00,0x00,0x00,0x00,0x00,0x00,0x00,
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0x03,0x03,0x07,0x03,0x00,0x00,0x00,0x00,0x00,0x00,0x00,0x00,0x00,0x00,0x00,0x00,
};







/**********************************************************************************************
*函数：void Init( void )
*功能：平台初始化
*输入：无
*输出：无
*特殊说明：无
**********************************************************************************************/
void Init() {
    // 开发板平台初始化
    BoardInitMcu();
    BoardInitPeriph();
    keys_init();//按键初始化
    setTimer2Callback(Time2Handler);
    Tim2McuInit(1);//定时器初始化，设置定时中断1ms中断一次
	 
}

/**********************************************************************************************
*函数：void KeyDownHandler( void )
*功能：按钮事件监听
*输入：无
*输出：无
*特殊说明：无
**********************************************************************************************/
void KeyDownHandler(void) {
	
}

/**********************************************************************************************
*函数：void handlerPre10Ms( void )
*功能：10毫秒循环
*输入：无
*输出：无
*特殊说明：循环处理总时长300ms
**********************************************************************************************/
void handlerPre10Ms(void) {
    for (int delay = 0; delay < 30; delay++) {
        HAL_Delay(10);
        
    }
}


void OLED_State(){
	
	

	OLED_ShowString(0,6,"LED1        LED2");
	if(state == 0x00){
		GpioWrite(&Led1,1);GpioWrite(&Led2,1);
	OLED_DrawBMP(0,0,48,48,BMP0);
	OLED_DrawBMP(48+32,0,48,48,BMP0);
	}
	if(state == 0xFF){
	OLED_DrawBMP(0,0,48,48,BMP1);
		GpioWrite(&Led1,0);GpioWrite(&Led2,0);
	OLED_DrawBMP(48+32,0,48,48,BMP1);
	}
		if(state == 0xF0){
			GpioWrite(&Led2,0);GpioWrite(&Led1,1);
	OLED_DrawBMP(0,0,48,48,BMP0);
	OLED_DrawBMP(48+32,0,48,48,BMP1);
	}
	if(state == 0x0F){
		GpioWrite(&Led1,0);GpioWrite(&Led2,1);
	OLED_DrawBMP(0,0,48,48,BMP1);
	OLED_DrawBMP(48+32,0,48,48,BMP0);
	}
	
	
}



/**
 * Main application entry point.
 */
int main( void )
{
    Init();
	OLED_Init();
		NS_RadioInit(433000001,16,1000,1000);
    while( 1 )
    {ReadRadioRxBuffer(&state);
			OLED_State();
    }
}
